## arch/arm/hotplug/Kconfig
```kconfig
config CLUSTER_PLUG
	tristate "Cluster-Plug hotplug driver for homogeneous ARM big.LITTLE systems"
        default n
        help
          CPU hotplug driver designed for ARM big.LITTLE systems where
          both the big and little CPUs are of the same type. On these
          systems, it preferable to normall use the big cluster, and
          only activate the little cluster for highly parallel loads.
          This hotplug implementation always keeps the big cluster
          online, and only activates the little cluster for heavy
          parallel loads.

config THUNDERPLUG_CONTROL
	tristate "Thunderplug - plugging down/up of multi-cores using powersuspend"
        default n
 	    help
 	       This driver uses powersuspend to take down the cpu cores on a octa core device.

config STATE_HELPER
        tristate "State Notifier & Helper"
        default n
	depends on STATE_NOTIFIER
 	    help
 	       This driver hotplugs cores based on battery level (Quadcore)
```
